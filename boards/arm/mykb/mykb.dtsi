#include <nrf52840_nrf52dk.dtsi>

/ {
    chosen {
        zmk,kscan = &kscan0;
    };

    kscan0: kscan {
        compatible = "zmk,kscan-gpio-direct";
        status = "okay";

        input-keys
            = <0 6 GPIO_ACTIVE_LOW>  /* UP */
            ,<0 7 GPIO_ACTIVE_LOW>  /* DOWN */
            ,<0 8 GPIO_ACTIVE_LOW>  /* LEFT */
            ,<0 9 GPIO_ACTIVE_LOW>  /* RIGHT */
            ,<0 10 GPIO_ACTIVE_LOW> /* VOL+ */
            ,<0 11 GPIO_ACTIVE_LOW> /* VOL- */
        ;
    };
};
