## boards/arm/nrf52840_custom/Kconfig.board
```kconfig
config BOARD_NRF52840_CUSTOM
	bool "nrf52840_custom board"
	depends on SOC_NRF52840
```

## boards/shields/mykb/Kconfig.defconfig
```kconfig
if SHIELD_MYKB

def_bool $(shields_list_contains,mykb)

config ZMK_KEYBOARD_NAME
	default "mykb"

endif
```

## config/west.yml
```yaml
manifest:
  remotes:
    - name: zmkfirmware
      url-base: https://github.com/zmkfirmware
  projects:
    - name: zmk
      remote: zmkfirmware
      revision: main
      import: app/west.yml
  self:
    path: config
    # 如果要使用extra‑modules，必须放在self下面，不能写在manifest顶层
    # extra-modules:
    #   - your‑module‑name
```
