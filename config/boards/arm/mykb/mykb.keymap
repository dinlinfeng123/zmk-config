#include <behaviors.dtsi>
#include <dt-bindings/zmk/keys.h>

/ {
    keymap0: keymap {
        compatible = "zmk,keymap";
        default_layer {
            bindings = <
                &kp UP
                &kp DOWN
                &kp LEFT
                &kp RIGHT
                &kp H
                &kp LCONTROL
                &kp ESC
                &kp ENTER
                &kp SPACE
            >;
        };
    };
};
