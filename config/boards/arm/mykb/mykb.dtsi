#include <nrf52840dk_nrf52840.dtsi>

/ {
    kscan_0: kscan {
        compatible = "zmk,kscan-gpio-direct";
        input-gpios =
            <&gpio0 28 GPIO_ACTIVE_LOW>,
            <&gpio0 29 GPIO_ACTIVE_LOW>,
            <&gpio0 30 GPIO_ACTIVE_LOW>,
            <&gpio0 31 GPIO_ACTIVE_LOW>,
            <&gpio1  0 GPIO_ACTIVE_LOW>,
            <&gpio1  1 GPIO_ACTIVE_LOW>,
            <&gpio1  2 GPIO_ACTIVE_LOW>,
            <&gpio1  3 GPIO_ACTIVE_LOW>,
            <&gpio1  4 GPIO_ACTIVE_LOW>;
    };

    chosen {
        zmk,kscan = &kscan_0;
        zmk,keymap = &keymap0;
    };
};
