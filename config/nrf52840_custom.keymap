#include <boards/arm/nice_nano/nice_nano_nrf52840.dts>
#include <dt-bindings/zmk/keys.h>

/ {
    kscan: kscan {
        compatible = "zmk,kscan-gpio-direct";
        debounce-press-ms = <5>;
        debounce-release-ms = <5>;

        input-gpios =
            /* 顺序必须和keymap bindings一一对应！！ */
            <&gpio0 17 GPIO_ACTIVE_LOW>,   /* 0: UP */
            <&gpio0 20 GPIO_ACTIVE_LOW>,   /* 1: DOWN */
            <&gpio0 22 GPIO_ACTIVE_LOW>,   /* 2: LEFT */
            <&gpio0 24 GPIO_ACTIVE_LOW>,   /* 3: RIGHT */
            <&gpio1 0  GPIO_ACTIVE_LOW>,   /* 4: H */
            <&gpio0 11 GPIO_ACTIVE_LOW>,   /* 5: LCTRL */
            <&gpio1 4  GPIO_ACTIVE_LOW>,   /* 6: ESC */
            <&gpio1 6  GPIO_ACTIVE_LOW>,   /* 7: ENTER */
            <&gpio0 9  GPIO_ACTIVE_LOW>;   /* 8: SPACE */
    };
};

/ {
    keymap {
        compatible = "zmk,keymap";
        default_layer {
            /* bindings顺序严格对应上面input‑gpios的顺序，不能乱序 */
            bindings = <
                KC_UP
                KC_DOWN
                KC_LEFT
                KC_RIGHT
                KC_H
                KC_LCTRL
                KC_ESC
                KC_ENTER
                KC_SPACE
            >;
        };
    };
};
