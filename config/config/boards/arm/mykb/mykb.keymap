#include <behaviors.dtsi>
#include <dt-bindings/zmk/keys.h>

/ {
    keymap {
        compatible = "zmk,keymap";
        default_layer {
            bindings = <
                &kp UP        // P0.17 向上箭头
                &kp DOWN      // P0.20 向下箭头
                &kp LEFT      // P0.22 向左箭头
                &kp RIGHT     // P0.24 向右箭头
                &kp H         // P1.00 H
                &kp LCONTROL  // P0.11 CTRL
                &kp ESC       // P1.04 ESC
                &kp ENTER     // P1.06 回车
                &kp SPACE     // P0.09 空格
            >;
        };
    };
};
